## firmware/radio/main/Kconfig.projbuild
```kconfig
menu "ESP-FC Next radio"

config ESPFC_RADIO_SPI_MOSI
    int "SPI slave MOSI GPIO (from P4)"
    default 8
config ESPFC_RADIO_SPI_MISO
    int "SPI slave MISO GPIO (to P4)"
    default 9
config ESPFC_RADIO_SPI_SCLK
    int "SPI slave SCLK GPIO"
    default 6
config ESPFC_RADIO_SPI_CS
    int "SPI slave CS GPIO"
    default 10
    help
        Radio board pins, hardware/boards.py (C5 dict); avoids the C5 strapping pins.

config ESPFC_RADIO_CHANNEL
    int "Wi-Fi channel for ESP-NOW (all swarm members and the ground bridge)"
    range 1 13
    default 1

endmenu
```

## firmware/radio/sdkconfig.defaults
```kconfig
CONFIG_IDF_TARGET="esp32c5"
CONFIG_FREERTOS_HZ=1000
CONFIG_COMPILER_OPTIMIZATION_PERF=y
```
